## Documentation/devicetree/bindings/hwmon/eswin,eic7700-fan-control.yaml
```yaml
# SPDX-License-Identifier: (GPL-2.0-only OR BSD-2-Clause)
%YAML 1.2
---
$id: http://devicetree.org/schemas/hwmon/eswin,eic7700-fan-control.yaml#
$schema: http://devicetree.org/meta-schemas/core.yaml#

title: ESWIN EIC7700 fan tachometer

maintainers:
  - Han Gao <gaohan@iscas.ac.cn>

description:
  The controller counts APB clock cycles between tachometer pulses.

properties:
  compatible:
    const: eswin,eic7700-fan-control

  reg:
    maxItems: 1

  interrupts:
    maxItems: 1

  clocks:
    maxItems: 1

  resets:
    maxItems: 1

  pulses-per-revolution:
    description: Number of tachometer pulses per fan revolution.
    $ref: /schemas/types.yaml#/definitions/uint32
    enum: [1, 2, 4]

required:
  - compatible
  - reg
  - interrupts
  - clocks
  - resets
  - pulses-per-revolution

additionalProperties: false

examples:
  - |
    fan-controller@50b50000 {
        compatible = "eswin,eic7700-fan-control";
        reg = <0x50b50000 0x10000>;
        interrupts = <354>;
        clocks = <&clk 243>;
        resets = <&reset 110>;
        pulses-per-revolution = <2>;
    };
```

## Documentation/devicetree/bindings/timer/spacemit,k1-timer.yaml
```yaml
# SPDX-License-Identifier: (GPL-2.0-only OR BSD-2-Clause)
%YAML 1.2
---
$id: http://devicetree.org/schemas/timer/spacemit,k1-timer.yaml#
$schema: http://devicetree.org/meta-schemas/core.yaml#

title: SpacemiT K1 timer

maintainers:
  - Troy Mitchell <troy.mitchell@linux.spacemit.com>

description:
  The timer block contains three 32-bit up counters, each with three match
  comparators and an interrupt output. Each counter can use the functional
  clock or the internal 32.768 kHz clock and supports free-running and
  periodic operation.

properties:
  compatible:
    oneOf:
      - const: spacemit,k1-timer
      - items:
          - const: spacemit,k3-timer
          - const: spacemit,k1-timer

  reg:
    maxItems: 1

  interrupts:
    minItems: 1
    items:
      - description: Counter 0 interrupt
      - description: Counter 1 interrupt
      - description: Counter 2 interrupt

  clocks:
    items:
      - description: Functional clock
      - description: APB bus clock

  clock-names:
    items:
      - const: func
      - const: bus

  resets:
    maxItems: 1

required:
  - compatible
  - reg
  - interrupts
  - clocks
  - clock-names
  - resets

additionalProperties: false

examples:
  - |
    #include <dt-bindings/clock/spacemit,k1-syscon.h>

    timer@d4014000 {
        compatible = "spacemit,k1-timer";
        reg = <0xd4014000 0x100>;
        interrupts = <23>;
        clocks = <&syscon_apbc CLK_TIMERS1>,
                 <&syscon_apbc CLK_TIMERS1_BUS>;
        clock-names = "func", "bus";
        resets = <&syscon_apbc RESET_TIMERS1>;
    };
```
